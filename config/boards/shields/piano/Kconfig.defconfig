## config/boards/shields/piano/Kconfig.defconfig
```kconfig
if SHIELD_PIANO_DONGLE

config ZMK_KEYBOARD_NAME
	default "The Piano"

config ZMK_SPLIT_ROLE_CENTRAL
	default y

config ZMK_SPLIT_BLE_CENTRAL_PERIPHERALS
	default 2

endif

if SHIELD_PIANO_DONGLE || SHIELD_PIANO_LEFT || SHIELD_PIANO_RIGHT

config ZMK_SPLIT
	default y

endif
```

## config/boards/shields/piano/Kconfig.shield
```kconfig
config SHIELD_PIANO_DONGLE
	def_bool $(shields_list_contains,piano_dongle)

config SHIELD_PIANO_LEFT
	def_bool $(shields_list_contains,piano_left)

config SHIELD_PIANO_RIGHT
	def_bool $(shields_list_contains,piano_right)
```
